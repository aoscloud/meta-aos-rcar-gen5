## conf/layer.conf
```bitbake
# We have a conf and classes directory, add to BBPATH
BBPATH .= ":${LAYERDIR}"

# We have recipes-* directories, add to BBFILES
BBFILES += "${LAYERDIR}/recipes-*/*/*.bb \
            ${LAYERDIR}/recipes-*/*/*.bbappend"

BBFILE_COLLECTIONS += "meta-aos-rcar-gen5"
BBFILE_PATTERN_meta-aos-rcar-gen5 = "^${LAYERDIR}/"
BBFILE_PRIORITY_meta-aos-rcar-gen5 = "12"

LAYERSERIES_COMPAT_meta-aos-rcar-gen5 = "kirkstone"
```
